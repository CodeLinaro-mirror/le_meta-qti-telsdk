## conf/layer.conf
```bitbake
BBPATH .= ":${LAYERDIR}"
BBFILES += " ${LAYERDIR}/recipes-*/*/*.bb \
             ${LAYERDIR}/recipes-*/*/*.bbappend"
BBFILE_COLLECTIONS += "qti-telsdk"
BBFILE_PRIORITY_qti-telsdk = "17"
BBFILE_PATTERN_qti-telsdk := "^${LAYERDIR}/"
LAYERSERIES_COMPAT_qti-telsdk = "dunfell kirkstone"
```
